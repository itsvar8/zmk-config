## boards/shields/chrs/Kconfig.defconfig
```kconfig
if SHIELD_CHRS

# Name must be less than 16 characters long!
config ZMK_KEYBOARD_NAME
    default "chrs"

endif

# ---------------------
# Kconfig for shield "chrs" with board "nice_nano_v2"
# ---------------------
if BOARD_NICE_NANO_V2 && SHIELD_CHRS

config SPI
    default y

config WS2812_STRIP
    default y

endif
```

## boards/shields/var_corne/Kconfig.shield
```kconfig
config SHIELD_VAR_CORNE_LEFT
    def_bool $(shields_list_contains,var_corne_left)
  
config SHIELD_VAR_CORNE_RIGHT
    def_bool $(shields_list_contains,var_corne_right)
  
```
